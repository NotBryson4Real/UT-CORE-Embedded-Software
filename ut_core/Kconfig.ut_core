## ut_core/Kconfig.ut_core
```kconfig
config BOARD_UT_CORE
	bool "UT-CORE (STM32U5A5)"
	# Selecting the SoC here ensures the correct compiler flags, startup code,
	# and STM32 HAL drivers are included in the build.
	select SOC_STM32U5A5XX
```

## ut_core/board.yml
```yaml
board:
  name: ut_core                   # The unique identifier used in the build command (west build -b ut_core)
  full_name: UT-CORE STM32U5      # Human-readable name for documentation and menus
  vendor: utah_tech               # Vendor namespace for grouping boards
  socs:
    - name: stm32u5a5xx           # Critical: Links this board to the specific Zephyr SoC family definition
```

## ut_core/ut_core_defconfig
```kconfig
# Enable the GPIO driver so we can toggle pins
CONFIG_GPIO=y

# Explicitly disable the Serial Console for initial bring-up.
# This avoids boot hangs if the UART pins are not yet correctly defined.
CONFIG_SERIAL=n
CONFIG_CONSOLE=y
CONFIG_PRINTK=y
CONFIG_UART_CONSOLE=n

# Enable the Memory Protection Unit and Stack Protection.
# This causes the CPU to fault immediately on stack overflows, aiding debugging.
CONFIG_ARM_MPU=y
CONFIG_HW_STACK_PROTECTION=y

# Enable the STM32 Clock Control driver.
# This allows Zephyr to configure the RCC registers based on the Device Tree settings.
CONFIG_CLOCK_CONTROL=y
CONFIG_CLOCK_CONTROL_STM32_CUBE=y

CONFIG_USE_SEGGER_RTT=y
CONFIG_RTT_CONSOLE=y
```
